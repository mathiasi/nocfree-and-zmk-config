## diagnostics/int-probe/module/Kconfig
```kconfig
# SPDX-License-Identifier: MIT

config NOCFREE_INT_PROBE
    bool "Probe the PCA9555 interrupt line and report it as keystrokes"
    default y
    depends on DT_HAS_NOCFREE_BEHAVIOR_INT_PROBE_ENABLED
    depends on GPIO
    help
      DIAGNOSTIC, not for the shipped build. Watches one GPIO and counts
      edges on it, so the expander INT line can be confirmed on hardware
      before any scanning code is made to depend on it. Changes nothing
      about scanning: if the pin is wrong, the keyboard behaves exactly as
      it does now and the count simply stays at zero.

config NOCFREE_INT_PROBE_UNUSED_PIN
    int "GPIO0 pin carrying the expander INT line"
    default 31
    depends on NOCFREE_INT_PROBE
    help
      The porting guide's alias table publishes D1 = P0.31 as the PCA9555
      INT on the LEFT half, and D0 = P0.05 on the right. Neither has ever
      been driven by this port, which is what the probe is for.
```

## diagnostics/int-probe/module/dts/bindings/behavior/nocfree,behavior-int-probe.yaml
```yaml
# SPDX-License-Identifier: MIT

description: Types the state of the probed interrupt line as keystrokes

compatible: "nocfree,behavior-int-probe"

include: zero_param.yaml

properties:
  tap-ms:
    type: int
    description: Milliseconds between queued taps. Defaults to 15.
```
